## boards/xihu/Kconfig.xihu
```kconfig
# Copyright (c) 2016 Linaro Limited.
# SPDX-License-Identifier: Apache-2.0

config BOARD_XIHU
	select SOC_STM32F407XE
```

## boards/xihu/board.yml
```yaml
board:
  name: xihu
  full_name: 407开发板
  vendor: zw
  socs:
    - name: stm32f407xx
```
